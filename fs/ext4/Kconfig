## fs/overlayfs/Kconfig
```kconfig
config OVERLAY_FS
	tristate "Overlay filesystem support"
	help
	  An overlay filesystem combines two filesystems - an 'upper' filesystem
	  and a 'lower' filesystem.  When a name exists in both filesystems, the
	  object in the 'upper' filesystem is visible while the object in the
	  'lower' filesystem is either hidden or, in the case of directories,
	  merged with the 'upper' object.

	  For more information see Documentation/filesystems/overlayfs.txt

config OVERLAY_FS_REDIRECT_DIR
	bool "Overlayfs: turn on redirect dir feature by default"
	depends on OVERLAY_FS
	help
	  If this config option is enabled then overlay filesystems will use
	  redirects when renaming directories by default.  In this case it is
	  still possible to turn off redirects globally with the
	  "redirect_dir=off" module option or on a filesystem instance basis
	  with the "redirect_dir=off" mount option.

	  Note, that redirects are not backward compatible.  That is, mounting
	  an overlay which has redirects on a kernel that doesn't support this
	  feature will have unexpected results.

config OVERLAY_FS_REDIRECT_DIR_FH
	bool "Overlayfs: default to redirect dir by file handle"
	depends on OVERLAY_FS_REDIRECT_DIR
	help
	  If this config option is enabled then overlay filesystems will use
	  redirects by file handle for merged directories by default. It is
	  also possible to turn on redirect by file handle globally with the
	  "redirect_dir=fh" module option or on a filesystem instance basis
	  with the "redirect_dir=fh" mount option.

	  Note, that redirects by file handle are not compatible with redirect
	  by absolute path.  That is, mounting an overlay which has both file
	  handle redirects and absolute path redirects will have unexpected
	  results.

config OVERLAY_FS_SNAPSHOT
	bool "Overlayfs snapshot support (Experimental)"
	depends on OVERLAY_FS

	help
	  This enables experimental support for overlayfs snapshot.
	  If unsure, say N
```
